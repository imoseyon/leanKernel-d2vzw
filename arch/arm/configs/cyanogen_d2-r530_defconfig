## arch/arm/mach-msm/Kconfig.local
```kconfig
choice
	prompt "Target Locale"
	default TARGET_LOCALE_USA

config TARGET_LOCALE_USA
	bool "USA"

config TARGET_LOCALE_EUR
	bool "Europe Open"
endchoice

choice
	prompt "KONA Target Carrier"
	depends on MACH_KONA && (TARGET_LOCALE_EUR || TARGET_LOCALE_USA)
	default MACH_KONA_USA_ATT

config MACH_KONA_USA_ATT
	bool "ATT"
config MACH_KONA_EUR_OPEN
	bool "Europe Open"
endchoice
```

## drivers/accessory/Kconfig
```kconfig
#
# Accessory Configuration
#
source "drivers/accessory/mhl_tab_v2/Kconfig"

menuconfig ACCESSORY
	bool "Accessory devices"
	default n
	---help---
	Provides support for detecting Accessory such as TA, Keyboard, OTG

	Say Y here to get to see options for Samsung Accessories
	If you say N, all options in this submenu will be skipped and disabled.

if ACCESSORY

config 30PIN_CONN
        tristate "Accessory detection driver"

config SEC_KEYBOARD_DOCK
	tristate "sec keyboard dock support"

config CAMERON_HEALTH
	bool "Cameron Health device support"
	default n
endif # ACCESSORY
```

## drivers/accessory/mhl_tab_v2/Kconfig
```kconfig
#
# Copyright (c) 2012 SAMSUNG INDIA SOFTWARE OPERATIONS
#
# Manoj Prabhu B
#	prabhu.manoj@samsung.com


config VIDEO_MHL_TAB_V2
	bool "Samsung Mobile HD Link Interface"
	depends on MSM_VIDC && ARCH_MSM
	default n

config MHL_D3_SUPPORT
	bool "Support D3 mode in mhl"
	default n

config MHL_NEW_CBUS_MSC_CMD
	bool "Read DCAP for distinguish TA and USB"
	default n

config MHL_SWING_LEVEL
	bool "Tune mhl drive strength"
	default n
```

## drivers/felica/Kconfig
```kconfig
config FELICA
	bool "FeliCa driver"
	default n

config FELICA_DIAG
	bool "FeliCa driver"
	default n

config FELICA_NO_SECURE
	bool "FeliCa no secure"
	default n
```

## drivers/input/keyboard/cypress_touchkey_236/Kconfig
```kconfig
#
# Cypress touchkey configuration
#

config KEYBOARD_CYPRESS_TOUCH_236
        tristate "Cypress touchkey support"
        default n
        help
          Say Y here to enable the
	  cypress touchkey.
          To compile this driver as a
	  module, choose M here.

config KEYBOARD_CYPRESS_TOUCH_BLN
	bool "Cypress touchkey BLN support"
	default n
	help
	  Say Y here to enable the
	  cypress touchkey backlight
	  as a notification LED.
```

## drivers/media/nmi326/Kconfig
```kconfig
#
# Configuration for nmi_hw (ISDB-T)
#

config ISDBT_NMI
	bool "Samsung ISDB-T NMI Driver"
	default n

config ISDBT_NMI_DEBUG
	bool "print ISDB-T NMI debug message"
	depends on ISDBT_NMI
	default n
```

## drivers/misc/mpu3050/Kconfig
```kconfig
config MPU_SENSORS_TIMERIRQ_NEW
    tristate "MPU Timer IRQ"
    help
      If you say yes here you get access to the timerirq device handle which
      can be used to select on.  This can be used instead of IRQ's, sleeping,
      or timer threads.  Reading from this device returns the same type of
      information as reading from the MPU and slave IRQ's.

menuconfig: INV_SENSORS
    tristate "Motion Processing Unit"
    depends on I2C
    default y

if INV_SENSORS  

choice 
    prompt "MPU Master"
    depends on I2C && INV_SENSORS
    default MPU_SENSORS_MPU3050_NEW

config MPU_SENSORS_MPU3050_NEW
    bool "MPU3050"
    depends on I2C
    select MPU_SENSORS_MPU3050_GYRO
    help
      If you say yes here you get support for the MPU3050 Gyroscope driver
      This driver can also be built as a module.  If so, the module
      will be called mpu3050.

config MPU_SENSORS_MPU6050A2
    bool "MPU6050A2"
    depends on I2C
    select MPU_SENSORS_MPU6050_GYRO
    select MPU_SENSORS_MPU6050_ACCEL
    help
      If you say yes here you get support for the MPU6050A2 Gyroscope driver
      This driver can also be built as a module.  If so, the module
      will be called mpu6050a2.

config MPU_SENSORS_MPU6050B1
    bool "MPU6050B1"
    select MPU_SENSORS_MPU6050_GYRO
    select MPU_SENSORS_MPU6050_ACCEL
    depends on I2C
    help
      If you say yes here you get support for the MPU6050 Gyroscope driver
      This driver can also be built as a module.  If so, the module
      will be called mpu6050b1.

endchoice

choice
    prompt "Gyroscope Type"
    depends on I2C && INV_SENSORS
    default MPU_SENSORS_MPU3050_GYRO

config MPU_SENSORS_MPU3050_GYRO
    bool "MPU3050 built in gyroscope"
    depends on MPU_SENSORS_MPU3050_NEW

config MPU_SENSORS_MPU6050_GYRO
    bool "MPU6050 built in gyroscope"
    depends on MPU_SENSORS_MPU6050B1 || MPU_SENSORS_MPU6050A2

endchoice

choice
    prompt "Accelerometer Type"
    depends on I2C
    default MPU_SENSORS_BMA150

config MPU_SENSORS_ACCELEROMETER_NONE_NEW
    bool "NONE"
    depends on MPU_SENSORS_MPU3050_NEW
    help
      This disables accelerometer support for the MPU3050

config MPU_SENSORS_MPU6050_ACCEL
    bool "MPU6050 built in accelerometer"
    depends on MPU_SENSORS_MPU6050B1 || MPU_SENSORS_MPU6050A2

config MPU_SENSORS_ADXL34X
    bool "ADI adxl34x"
    depends on MPU_SENSORS_MPU3050_NEW
    help
      This enables support for the ADI adxl345 or adxl346 accelerometers

config MPU_SENSORS_BMA150_NEW
    bool "Bosch BMA150"
    depends on MPU_SENSORS_MPU3050_NEW
    help
      This enables support for the Bosch BMA150 accelerometer
 
config MPU_SENSORS_BMA222_NEW
    bool "Bosch BMA222"
    depends on MPU_SENSORS_MPU3050_NEW
    help
      This enables support for the Bosch BMA222 accelerometer

config MPU_SENSORS_BMA250_NEW
    bool "Bosch BMA250"
    depends on MPU_SENSORS_MPU3050_NEW
    help
      This enables support for the Bosch BMA250 accelerometer
      
config MPU_SENSORS_KXSD9_NEW
    bool "Kionix KXSD9"
    depends on MPU_SENSORS_MPU3050_NEW
    help
      This enables support for the Kionix KXSD9 accelerometer

config MPU_SENSORS_KXTF9_NEW
    bool "Kionix KXTF9"
    depends on MPU_SENSORS_MPU3050_NEW
    help
      This enables support for the Kionix KXFT9 accelerometer

config MPU_SENSORS_LIS331DLH_NEW
    bool "ST lis331dlh"
    depends on MPU_SENSORS_MPU3050_NEW
    help
      This enables support for the ST lis331dlh accelerometer

config MPU_SENSORS_LIS3DH_NEW
    bool "ST lis3dh"
    depends on MPU_SENSORS_MPU3050_NEW
    help
      This enables support for the ST lis3dh accelerometer

config MPU_SENSORS_LSM303DLHA_NEW
    bool "ST lsm303dlh"
    depends on MPU_SENSORS_MPU3050_NEW
    help
      This enables support for the ST lsm303dlh accelerometer

config MPU_SENSORS_MMA8450_NEW
    bool "Freescale mma8450"
    depends on MPU_SENSORS_MPU3050_NEW
    help
      This enables support for the Freescale mma8450 accelerometer

config MPU_SENSORS_MMA845X_NEW
    bool "Freescale mma8451/8452/8453"
    depends on MPU_SENSORS_MPU3050_NEW
    help
      This enables support for the Freescale mma8451/8452/8453 accelerometer

endchoice

choice
    prompt "Compass Type"
    default MPU_SENSORS_AK8975_NEW

config MPU_SENSORS_COMPASS_NONE_NEW
    bool "NONE"
    help
      This disables compass support for the MPU6050

config MPU_SENSORS_AK8975_NEW
    bool "AKM ak8975"
    help
      This enables support for the AKM ak8975 compass

config MPU_SENSORS_MMC314X_NEW
    bool "MEMSIC mmc314x"
    help
      This enables support for the MEMSIC mmc314x compass

config MPU_SENSORS_AMI30X_NEW
    bool "Aichi Steel ami30X"
    help
      This enables support for the Aichi Steel ami304/ami305 compass

config MPU_SENSORS_AMI306_NEW
    bool "Aichi Steel ami306"
    help
      This enables support for the Aichi Steel ami306 compass

config MPU_SENSORS_HMC5883_NEW
    bool "Honeywell hmc5883"
    help
      This enables support for the Honeywell hmc5883 compass

config MPU_SENSORS_LSM303DLHM_NEW
    bool "ST lsm303dlh"
    help
      This enables support for the ST lsm303dlh compass

config MPU_SENSORS_MMC314X_NEW
    bool "MEMSIC mmc314xMS"
    help
      This enables support for the MEMSIC mmc314xMS compass

config MPU_SENSORS_YAS529_NEW
    bool "Yamaha yas529"
    depends on INPUT_YAS_MAGNETOMETER
    help
      This enables support for the Yamaha yas529 compass

config MPU_SENSORS_YAS530_NEW
    bool "Yamaha yas530"
    help
      This enables support for the Yamaha yas530 compass

config MPU_SENSORS_HSCDTD002B_NEW
    bool "Alps hscdtd002b"
    help
      This enables support for the Alps hscdtd002b compass

config MPU_SENSORS_HSCDTD004A_NEW
    bool "Alps hscdtd004a"
    help
      This enables support for the Alps hscdtd004a compass

endchoice

choice
    prompt "Pressure Type"
    default MPU_SENSORS_PRESSURE_NONE_NEW

config MPU_SENSORS_PRESSURE_NONE_NEW
    bool "NONE"
    help
      This disables pressure sensor support for the MPU6050

config MPU_SENSORS_BMA085_NEW
    bool "Bosch BMA085"
    help
      This enables support for the Bosch bma085 pressure sensor

endchoice

endif #INV_SENSORS
```

## drivers/misc/yas532/Kconfig
```kconfig
menuconfig: INPUT_YAS_SENSORS
	bool "Yas 532 Sensors Support"
	depends on I2C
	default n
	help
	  Say Y to enable Sensors support.  This allows control of supported
	  Sensors.

if INPUT_YAS_SENSORS
source "drivers/misc/yas532/accelerometer/Kconfig"
source "drivers/misc/yas532/geomagnetic/Kconfig"
source "drivers/misc/yas532/orientation/Kconfig"
endif # INPUT_YAS_SENSORS
```

## drivers/motor/Kconfig
```kconfig
#
# Immersion TouchSense Player driver configuration
#
menuconfig VIBETONZ
        tristate "Vibetonz"
        default n
        help
          Say Y to enable Vibetonz support.
```
